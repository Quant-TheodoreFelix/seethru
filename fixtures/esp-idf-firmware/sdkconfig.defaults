## fixtures/esp-idf-firmware/sdkconfig.defaults
```kconfig
CONFIG_PARTITION_TABLE_TWO_OTA=y
CONFIG_ESP_HTTPS_OTA_ALLOW_HTTP=y
CONFIG_SECURE_BOOT_ALLOW_JTAG=y
# CONFIG_SECURE_BOOT is not set
CONFIG_HTTPD_MAX_URI_HANDLERS=16
```
